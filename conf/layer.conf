## conf/layer.conf
```bitbake
# We have a conf and classes directory, append to BBPATH
BBPATH .= ":${LAYERDIR}"

# We have a recipes directory, add to BBFILES
BBFILES += "${LAYERDIR}/recipes*/*/*.bb ${LAYERDIR}/recipes*/*/*.bbappend"

BBFILE_COLLECTIONS += "calaos-layer"
BBFILE_PATTERN_calaos-layer := "^${LAYERDIR}/"
BBFILE_PRIORITY_calaos-layer = "6"

LAYERSERIES_COMPAT_calaos-layer = "thud warrior hardknott"
```
